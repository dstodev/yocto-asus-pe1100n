## sources/meta-pe1100n/conf/distro/mydistro.conf
```bitbake
DISTRO = "mydistro"
DISTRO_NAME = "My Example Distro"
DISTRO_VERSION = "1.0"
DISTRO_CODENAME = "Academia"
MAINTAINER = "Daniel <dstodev@gmail.com>"

LICENSE_FLAGS_ACCEPTED += "commercial"

MY_DEFAULT_DISTRO_FEATURES = "\
    systemd \
    "

MY_DEFAULT_EXTRA_RDEPENDS = ""
MY_DEFAULT_EXTRA_RDEPENDS = ""

MY_INIT_MANAGER = "systemd"

DISTRO_FEATURES ?= "${DISTRO_FEATURES_DEFAULT} ${MY_DEFAULT_DISTRO_FEATURES}"
DISTRO_EXTRA_RDEPENDS += "${MY_DEFAULT_EXTRA_RDEPENDS}"
DISTRO_EXTRA_RRECOMMENDS += "${MY_DEFAULT_EXTRA_RRECOMMENDS}"

require conf/distro/include/no-static-libs.inc
require conf/distro/include/security_flags.inc

INIT_MANAGER ?= "${MY_INIT_MANAGER}"
```

## sources/meta-pe1100n/conf/layer.conf
```bitbake
# We have a conf and classes directory, add to BBPATH
BBPATH .= ":${LAYERDIR}"

# We have recipes-* directories, add to BBFILES
BBFILES += "${LAYERDIR}/recipes-*/*/*.bb \
            ${LAYERDIR}/recipes-*/*/*.bbappend"

BBFILE_COLLECTIONS += "meta-pe1100n"
BBFILE_PATTERN_meta-pe1100n = "^${LAYERDIR}/"
BBFILE_PRIORITY_meta-pe1100n = "6"

LAYERDEPENDS_meta-pe1100n = "core tegra tegra-community"
LAYERSERIES_COMPAT_meta-pe1100n = "scarthgap"
```

## sources/meta-pe1100n/conf/machine/pe1100n.conf
```bitbake
# Following pattern from:
# https://github.com/OE4T/meta-tegra/wiki/Creating-a-custom-MACHINE#custom-machine-definitions-for-existing-hardware

MACHINEOVERRIDES =. "p3768-0000-p3767-0000:${MACHINE}:"

KERNEL_DEVICETREE ?= "tegra234-p3768-0000+p3767-0000-pe1100n.dtb"

TEGRA_FLASHVAR_PINMUX_CONFIG ?= "tegra234-mb1-bct-pinmux-p3767-hdmi-a03.dtsi"
TEGRA_FLASHVAR_PMC_CONFIG ?= "tegra234-mb1-bct-padvoltage-p3767-hdmi-a03.dtsi"

require conf/machine/p3768-0000-p3767-0000.conf

PACKAGE_EXTRA_ARCHS:append = " p3768-0000-p3767-0000"
```
